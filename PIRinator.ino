#include <SPI.h>
#include <Wire.h>
#include <Adafruit_GFX.h>
#include <Adafruit_SSD1306.h>

#define SCREEN_WIDTH 128  // OLED display width, in pixels
#define SCREEN_HEIGHT 64  // OLED display height, in pixels
Adafruit_SSD1306 display(SCREEN_WIDTH, SCREEN_HEIGHT, &Wire, -1);

int state = LOW;
int detected = 0;

// '6516569', 32x32px
const unsigned char epd_bitmap_6516569[] PROGMEM = {
  0xff, 0xff, 0xff, 0xff, 0xff, 0xff, 0xff, 0xff, 0xff, 0xff, 0xff, 0xff, 0xff, 0xff, 0xff, 0xff,
  0xff, 0xff, 0xff, 0xff, 0xff, 0xff, 0xff, 0xff, 0xf9, 0xff, 0xff, 0x9f, 0xf1, 0xff, 0xff, 0x8f,
  0xf1, 0xff, 0xff, 0x8f, 0xe3, 0x7f, 0x8e, 0xc7, 0xe6, 0x7f, 0x8e, 0x67, 0xc6, 0xff, 0x8f, 0x63,
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  0xff, 0xff, 0xff, 0xff, 0xff, 0xff, 0xff, 0xff, 0xff, 0xff, 0xff, 0xff, 0xff, 0xff, 0xff, 0xff
};

// Array of all bitmaps for convenience. (Total bytes used to store images in PROGMEM = 144)
const int epd_bitmap_allArray_LEN = 1;
const unsigned char* epd_bitmap_allArray[1] = {
  epd_bitmap_6516569
};


void setup() {
  // put your setup code here, to run once:
  Serial.begin(9600);

  // SSD1306_SWITCHCAPVCC = generate display voltage from 3.3V internally
  if (!display.begin(SSD1306_SWITCHCAPVCC, 0x3c)) {
    Serial.println(F("SSD1306 allocation failed"));
  }
  display.clearDisplay();
  display.setTextColor(WHITE);
  display.setTextSize(1);
  display.setCursor(38, 20);
  display.setCursor(39, 35);
  display.display();  //tampilkan data
  pinMode(5, INPUT);
}

void loop() {
  // put your main code here, to run repeatedly:
  detected = digitalRead(5);
  if (detected == HIGH) {
    display.drawBitmap(0, 0, epd_bitmap_6516569, 32, 32, BLACK, WHITE);
    display.display();  //tampilkan data
    if (state == LOW) {
      //  Serial.println("Motion Detected!");
      state == HIGH;
    }
  } else {
    display.clearDisplay();
    display.display();  //tampilkan data
    if (state == HIGH) {
      //  Serial.println("Motion Stopped!");
      state == LOW;
    }
  }
}
